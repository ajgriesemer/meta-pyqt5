## conf/layer.conf
```bitbake
# We have a conf and classes directory, add to BBPATH
BBPATH .= ":${LAYERDIR}"

# We have recipes-* directories, add to BBFILES
BBFILES += "${LAYERDIR}/recipes-*/*/*.bb \
	${LAYERDIR}/recipes-*/*/*.bbappend \
        ${LAYERDIR}/images/*.bb \
"

BBFILE_COLLECTIONS += "pyqt5"
BBFILE_PATTERN_pyqt5 = "^${LAYERDIR}/"
BBFILE_PRIORITY_pyqt5 = "8"
```
